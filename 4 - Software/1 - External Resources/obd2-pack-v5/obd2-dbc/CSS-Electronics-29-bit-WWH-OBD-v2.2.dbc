VERSION ""

NS_ :

BS_:

BU_:

BO_ 2564485397 OBD2: 8 Vector__XXX
 SG_ S62PID00_PIDsSupported_01_20 m0 : 39|32@0+ (1,0) [0|4294967295] "" Vector__XXX
 SG_ S62PID01_MonitorStatus m1 : 39|32@0+ (1,0) [0|4294967295] "" Vector__XXX
 SG_ S62PID02_FreezeDTC m2 : 39|16@0+ (1,0) [0|65535] "" Vector__XXX
 SG_ S62PID03_FuelSystemStatus m3 : 39|16@0+ (1,0) [0|65535] "" Vector__XXX
 SG_ S62PID04_CalcEngineLoad m4 : 39|8@0+ (0.39216,0) [0|100] "%" Vector__XXX
 SG_ S62PID05_EngineCoolantTemp m5 : 39|8@0+ (1,-40) [-40|215] "degC" Vector__XXX
 SG_ S62PID06_ShortFuelTrimBank1 m6 : 39|8@0+ (0.78125,-100) [-100|99.21875] "%" Vector__XXX
 SG_ S62PID07_LongFuelTrimBank1 m7 : 39|8@0+ (0.78125,-100) [-100|99.21875] "%" Vector__XXX
 SG_ S62PID08_ShortFuelTrimBank2 m8 : 39|8@0+ (0.78125,-100) [-100|99.21875] "%" Vector__XXX
 SG_ S62PID09_LongFuelTrimBank2 m9 : 39|8@0+ (0.78125,-100) [-100|99.21875] "%" Vector__XXX
 SG_ S62PID0A_FuelPressure m10 : 39|8@0+ (3,0) [0|765] "kPa" Vector__XXX
 SG_ S62PID0B_IntakeManiAbsPress m11 : 39|8@0+ (1,0) [0|255] "kPa" Vector__XXX
 SG_ S62PID0C_EngineRPM m12 : 39|16@0+ (0.25,0) [0|16383.75] "rpm" Vector__XXX
 SG_ S62PID0D_VehicleSpeed m13 : 39|8@0+ (1,0) [0|255] "km/h" Vector__XXX
 SG_ S62PID0E_TimingAdvance m14 : 39|8@0+ (0.5,-64) [-64|63.5] "deg before TDC" Vector__XXX
 SG_ S62PID0F_IntakeAirTemperature m15 : 39|8@0+ (1,-40) [-40|215] "degC" Vector__XXX
 SG_ S62PID10_MAFAirFlowRate m16 : 39|16@0+ (0.01,0) [0|655.35] "grams/sec" Vector__XXX
 SG_ S62PID11_ThrottlePosition m17 : 39|8@0+ (0.39216,0) [0|100] "%" Vector__XXX
 SG_ S62PID12_CmdSecAirStatus m18 : 39|8@0+ (1,0) [0|255] "" Vector__XXX
 SG_ S62PID14_OxySensor1_Volt m20 : 39|8@0+ (0.005,0) [0|1.275] "volts" Vector__XXX
 SG_ S62PID14_OxySensor1_STFT m20 : 47|8@0+ (0.78125,-100) [-100|99.21875] "%" Vector__XXX
 SG_ S62PID15_OxySensor2_Volt m21 : 39|8@0+ (0.005,0) [0|1.275] "volts" Vector__XXX
 SG_ S62PID15_OxySensor2_STFT m21 : 47|8@0+ (0.78125,-100) [-100|99.21875] "%" Vector__XXX
 SG_ S62PID16_OxySensor3_Volt m22 : 39|8@0+ (0.005,0) [0|1.275] "volts" Vector__XXX
 SG_ S62PID16_OxySensor3_STFT m22 : 47|8@0+ (0.78125,-100) [-100|99.21875] "%" Vector__XXX
 SG_ S62PID17_OxySensor4_Volt m23 : 39|8@0+ (0.005,0) [0|1.275] "volts" Vector__XXX
 SG_ S62PID17_OxySensor4_STFT m23 : 47|8@0+ (0.78125,-100) [-100|99.21875] "%" Vector__XXX
 SG_ S62PID18_OxySensor5_Volt m24 : 39|8@0+ (0.005,0) [0|1.275] "volts" Vector__XXX
 SG_ S62PID18_OxySensor5_STFT m24 : 47|8@0+ (0.78125,-100) [-100|99.21875] "%" Vector__XXX
 SG_ S62PID19_OxySensor6_Volt m25 : 39|8@0+ (0.005,0) [0|1.275] "volts" Vector__XXX
 SG_ S62PID19_OxySensor6_STFT m25 : 47|8@0+ (0.78125,-100) [-100|99.21875] "%" Vector__XXX
 SG_ S62PID1A_OxySensor7_Volt m26 : 39|8@0+ (0.005,0) [0|1.275] "volts" Vector__XXX
 SG_ S62PID1A_OxySensor7_STFT m26 : 47|8@0+ (0.78125,-100) [-100|99.21875] "%" Vector__XXX
 SG_ S62PID1B_OxySensor8_Volt m27 : 39|8@0+ (0.005,0) [0|1.275] "volts" Vector__XXX
 SG_ S62PID1B_OxySensor8_STFT m27 : 47|8@0+ (0.78125,-100) [-100|99.21875] "%" Vector__XXX
 SG_ S62PID1C_OBDStandard m28 : 39|8@0+ (1,0) [0|255] "" Vector__XXX
 SG_ S62PID1F_TimeSinceEngStart m31 : 39|16@0+ (1,0) [0|65535] "seconds" Vector__XXX
 SG_ S62PID20_PIDsSupported_21_40 m32 : 39|32@0+ (1,0) [0|4294967295] "" Vector__XXX
 SG_ S62PID21_DistanceMILOn m33 : 39|16@0+ (1,0) [0|65535] "km" Vector__XXX
 SG_ S62PID22_FuelRailPres m34 : 39|16@0+ (0.079,0) [0|5177.265] "kPa" Vector__XXX
 SG_ S62PID23_FuelRailGaug m35 : 39|16@0+ (10,0) [0|655350] "kPa" Vector__XXX
 SG_ S62PID24_OxySensor1_FAER m36 : 39|16@0+ (3.0517578125E-005,0) [0|2] "ratio" Vector__XXX
 SG_ S62PID24_OxySensor1_Volt m36 : 55|16@0+ (0.0001220703125,0) [0|2] "volts" Vector__XXX
 SG_ S62PID25_OxySensor2_FAER m37 : 39|16@0+ (3.0517578125E-005,0) [0|2] "ratio" Vector__XXX
 SG_ S62PID25_OxySensor2_Volt m37 : 55|16@0+ (0.0001220703125,0) [0|8] "volts" Vector__XXX
 SG_ S62PID26_OxySensor3_FAER m38 : 39|16@0+ (3.0517578125E-005,0) [0|2] "ratio" Vector__XXX
 SG_ S62PID26_OxySensor3_Volt m38 : 55|16@0+ (0.0001220703125,0) [0|8] "volts" Vector__XXX
 SG_ S62PID27_OxySensor4_FAER m39 : 39|16@0+ (3.0517578125E-005,0) [0|2] "ratio" Vector__XXX
 SG_ S62PID27_OxySensor4_Volt m39 : 55|16@0+ (0.0001220703125,0) [0|8] "volts" Vector__XXX
 SG_ S62PID28_OxySensor5_FAER m40 : 39|16@0+ (3.0517578125E-005,0) [0|2] "ratio" Vector__XXX
 SG_ S62PID28_OxySensor5_Volt m40 : 55|16@0+ (0.0001220703125,0) [0|8] "volts" Vector__XXX
 SG_ S62PID29_OxySensor6_FAER m41 : 39|16@0+ (3.0517578125E-005,0) [0|2] "ratio" Vector__XXX
 SG_ S62PID29_OxySensor6_Volt m41 : 55|16@0+ (0.0001220703125,0) [0|8] "volts" Vector__XXX
 SG_ S62PID2A_OxySensor7_FAER m42 : 39|16@0+ (3.0517578125E-005,0) [0|2] "ratio" Vector__XXX
 SG_ S62PID2A_OxySensor7_Volt m42 : 55|16@0+ (0.0001220703125,0) [0|8] "volts" Vector__XXX
 SG_ S62PID2B_OxySensor8_FAER m43 : 39|16@0+ (3.0517578125E-005,0) [0|2] "ratio" Vector__XXX
 SG_ S62PID2B_OxySensor8_Volt m43 : 55|16@0+ (0.0001220703125,0) [0|8] "volts" Vector__XXX
 SG_ S62PID2C_CmdEGR m44 : 39|8@0+ (0.392156862745098,0) [0|100] "%" Vector__XXX
 SG_ S62PID2D_EGRError m45 : 39|8@0+ (0.78125,-100) [-100|99.21875] "%" Vector__XXX
 SG_ S62PID2E_CmdEvapPurge m46 : 39|8@0+ (0.392156862745098,0) [0|100] "%" Vector__XXX
 SG_ S62PID2F_FuelTankLevel m47 : 39|8@0+ (0.392156862745098,0) [0|100] "%" Vector__XXX
 SG_ S62PID30_WarmUpsSinceCodeClear m48 : 39|8@0+ (1,0) [0|255] "count" Vector__XXX
 SG_ S62PID31_DistanceSinceCodeClear m49 : 39|16@0+ (1,0) [0|65535] "km" Vector__XXX
 SG_ S62PID32_EvapSysVaporPres m50 : 39|16@0- (0.25,0) [-8192|8191.75] "Pa" Vector__XXX
 SG_ S62PID33_AbsBaroPres m51 : 39|8@0+ (1,0) [0|255] "kPa" Vector__XXX
 SG_ S62PID34_OxySensor1_FAER m52 : 39|16@0+ (3.0517578125E-005,0) [0|2] "ratio" Vector__XXX
 SG_ S62PID34_OxySensor1_Crnt m52 : 55|16@0+ (0.00390625,-128) [-128|128] "mA" Vector__XXX
 SG_ S62PID35_OxySensor2_FAER m53 : 39|16@0+ (3.0517578125E-005,0) [0|2] "ratio" Vector__XXX
 SG_ S62PID35_OxySensor2_Crnt m53 : 55|16@0+ (0.00390625,-128) [-128|128] "mA" Vector__XXX
 SG_ S62PID36_OxySensor3_FAER m54 : 39|16@0+ (3.0517578125E-005,0) [0|2] "ratio" Vector__XXX
 SG_ S62PID36_OxySensor3_Crnt m54 : 55|16@0+ (0.00390625,-128) [-128|128] "mA" Vector__XXX
 SG_ S62PID37_OxySensor4_FAER m55 : 39|16@0+ (3.0517578125E-005,0) [0|2] "ratio" Vector__XXX
 SG_ S62PID37_OxySensor4_Crnt m55 : 55|16@0+ (0.00390625,-128) [-128|128] "mA" Vector__XXX
 SG_ S62PID38_OxySensor5_FAER m56 : 39|16@0+ (3.0517578125E-005,0) [0|2] "ratio" Vector__XXX
 SG_ S62PID38_OxySensor5_Crnt m56 : 55|16@0+ (0.00390625,-128) [-128|128] "mA" Vector__XXX
 SG_ S62PID39_OxySensor6_FAER m57 : 39|16@0+ (3.0517578125E-005,0) [0|2] "ratio" Vector__XXX
 SG_ S62PID39_OxySensor6_Crnt m57 : 55|16@0+ (0.00390625,-128) [-128|128] "mA" Vector__XXX
 SG_ S62PID3A_OxySensor7_FAER m58 : 39|16@0+ (3.0517578125E-005,0) [0|2] "ratio" Vector__XXX
 SG_ S62PID3A_OxySensor7_Crnt m58 : 55|16@0+ (0.00390625,-128) [-128|128] "mA" Vector__XXX
 SG_ S62PID3B_OxySensor8_FAER m59 : 39|16@0+ (3.0517578125E-005,0) [0|2] "ratio" Vector__XXX
 SG_ S62PID3B_OxySensor8_Crnt m59 : 55|16@0+ (0.00390625,-128) [-128|128] "mA" Vector__XXX
 SG_ S62PID3C_CatTempBank1Sens1 m60 : 39|16@0+ (0.1,-40) [-40|6513.5] "degC" Vector__XXX
 SG_ S62PID3D_CatTempBank2Sens1 m61 : 39|16@0+ (0.1,-40) [-40|6513.5] "degC" Vector__XXX
 SG_ S62PID3E_CatTempBank1Sens2 m62 : 39|16@0+ (0.1,-40) [-40|6513.5] "degC" Vector__XXX
 SG_ S62PID3F_CatTempBank2Sens2 m63 : 39|16@0+ (0.1,-40) [-40|6513.5] "degC" Vector__XXX
 SG_ S62PID40_PIDsSupported_41_60 m64 : 39|32@0+ (1,0) [0|4294967295] "" Vector__XXX
 SG_ S62PID41_MonStatusDriveCycle m65 : 39|32@0+ (1,0) [0|4294967295] "" Vector__XXX
 SG_ S62PID42_ControlModuleVolt m66 : 39|16@0+ (0.001,0) [0|65.535] "V" Vector__XXX
 SG_ S62PID43_AbsLoadValue m67 : 39|16@0+ (0.392156862745098,0) [0|25700] "%" Vector__XXX
 SG_ S62PID44_FuelAirCmdEquiv m68 : 39|16@0+ (3.0517578125E-005,0) [0|2] "ratio" Vector__XXX
 SG_ S62PID45_RelThrottlePos m69 : 39|8@0+ (0.392156862745098,0) [0|100] "%" Vector__XXX
 SG_ S62PID46_AmbientAirTemp m70 : 39|8@0+ (1,-40) [-40|215] "degC" Vector__XXX
 SG_ S62PID47_AbsThrottlePosB m71 : 39|8@0+ (0.392156862745098,0) [0|100] "%" Vector__XXX
 SG_ S62PID48_AbsThrottlePosC m72 : 39|8@0+ (0.392156862745098,0) [0|100] "%" Vector__XXX
 SG_ S62PID49_AbsThrottlePosD m73 : 39|8@0+ (0.392156862745098,0) [0|100] "%" Vector__XXX
 SG_ S62PID4A_AbsThrottlePosE m74 : 39|8@0+ (0.392156862745098,0) [0|100] "%" Vector__XXX
 SG_ S62PID4B_AbsThrottlePosF m75 : 39|8@0+ (0.392156862745098,0) [0|100] "%" Vector__XXX
 SG_ S62PID4C_CmdThrottleAct m76 : 39|8@0+ (0.392156862745098,0) [0|100] "%" Vector__XXX
 SG_ S62PID4D_TimeRunMILOn m77 : 39|16@0+ (1,0) [0|65535] "minutes" Vector__XXX
 SG_ S62PID4E_TimeSinceCodeClear m78 : 39|16@0+ (1,0) [0|65535] "minutes" Vector__XXX
 SG_ S62PID4F_Max_FAER m79 : 39|8@0+ (1,0) [0|255] "ratio" Vector__XXX
 SG_ S62PID4F_Max_OxySensVol m79 : 47|8@0+ (1,0) [0|255] "V" Vector__XXX
 SG_ S62PID4F_Max_OxySensCrnt m79 : 55|8@0+ (1,0) [0|255] "mA" Vector__XXX
 SG_ S62PID4F_Max_IntManiAbsPres m79 : 63|8@0+ (10,0) [0|2550] "kPa" Vector__XXX
 SG_ S62PID50_Max_AirFlowMAF m80 : 39|8@0+ (10,0) [0|2550] "g/s" Vector__XXX
 SG_ S62PID51_FuelType m81 : 39|8@0+ (1,0) [0|255] "" Vector__XXX
 SG_ S62PID52_EthanolFuelPct m82 : 39|8@0+ (0.392156862745098,0) [0|100] "%" Vector__XXX
 SG_ S62PID53_AbsEvapSysVapPres m83 : 39|16@0+ (0.005,0) [0|327.675] "kPa" Vector__XXX
 SG_ S62PID54_EvapSysVapPres m84 : 39|16@0+ (1,-32767) [-32767|32768] "Pa" Vector__XXX
 SG_ S62PID55_ShortSecOxyTrimBank1 m85 : 39|8@0+ (0.78125,-100) [-100|99.21875] "%" Vector__XXX
 SG_ S62PID55_ShortSecOxyTrimBank3 m85 : 47|8@0+ (0.78125,-100) [-100|99.21875] "%" Vector__XXX
 SG_ S62PID56_LongSecOxyTrimBank1 m86 : 39|8@0+ (0.78125,-100) [-100|99.21875] "%" Vector__XXX
 SG_ S62PID56_LongSecOxyTrimBank3 m86 : 47|8@0+ (0.78125,-100) [-100|99.21875] "%" Vector__XXX
 SG_ S62PID57_ShortSecOxyTrimBank2 m87 : 39|8@0+ (0.78125,-100) [-100|99.21875] "%" Vector__XXX
 SG_ S62PID57_ShortSecOxyTrimBank4 m87 : 47|8@0+ (0.78125,-100) [-100|99.21875] "%" Vector__XXX
 SG_ S62PID58_LongSecOxyTrimBank2 m88 : 39|8@0+ (0.78125,-100) [-100|99.21875] "%" Vector__XXX
 SG_ S62PID58_LongSecOxyTrimBank4 m88 : 47|8@0+ (0.78125,-100) [-100|99.21875] "%" Vector__XXX
 SG_ S62PID59_FuelRailAbsPres m89 : 39|16@0+ (10,0) [0|655350] "kPa" Vector__XXX
 SG_ S62PID5A_RelAccelPedalPos m90 : 39|8@0+ (0.392156862745098,0) [0|100] "%" Vector__XXX
 SG_ S62PID5B_HybrBatPackRemLife m91 : 39|8@0+ (0.392156862745098,0) [0|100] "%" Vector__XXX
 SG_ S62PID5C_EngineOilTemp m92 : 39|8@0+ (1,-40) [-40|215] "degC" Vector__XXX
 SG_ S62PID5D_FuelInjectionTiming m93 : 39|16@0+ (0.0078125,-210) [-210|301.9921875] "deg" Vector__XXX
 SG_ S62PID5E_EngineFuelRate m94 : 39|16@0+ (0.05,0) [0|3276.75] "L/h" Vector__XXX
 SG_ S62PID5F_EmissionReq m95 : 39|8@0+ (1,0) [0|255] "" Vector__XXX
 SG_ S62PID60_PIDsSupported_61_80 m96 : 39|32@0+ (1,0) [0|4294967295] "" Vector__XXX
 SG_ S62PID61_DemandEngTorqPct m97 : 39|8@0+ (1,-125) [-125|130] "%" Vector__XXX
 SG_ S62PID62_ActualEngTorqPct m98 : 39|8@0+ (1,-125) [-125|130] "%" Vector__XXX
 SG_ S62PID63_EngRefTorq m99 : 39|16@0+ (1,0) [0|65535] "Nm" Vector__XXX
 SG_ S62PID65_AuxInputOutput m101 : 39|8@0+ (1,0) [0|255] "" Vector__XXX
 SG_ S62PID66_MAFSensor m102 : 39|8@0+ (1,0) [0|255] "" Vector__XXX
 SG_ S62PID67_EngineCoolantTemp m103 : 39|8@0+ (1,0) [0|255] "" Vector__XXX
 SG_ S62PID68_IntakeAirTempSens m104 : 39|8@0+ (1,0) [0|255] "" Vector__XXX
 SG_ S62PID69_CmdEGR_EGRError m105 : 39|8@0+ (1,0) [0|255] "" Vector__XXX
 SG_ S62PID6A_CmdDieselIntAir m106 : 39|8@0+ (1,0) [0|255] "" Vector__XXX
 SG_ S62PID6B_ExhaustGasTemp m107 : 39|8@0+ (1,0) [0|255] "" Vector__XXX
 SG_ S62PID6C_CmdThrottleActRel m108 : 39|8@0+ (1,0) [0|255] "" Vector__XXX
 SG_ S62PID6D_FuelPresContrSys m109 : 39|8@0+ (1,0) [0|255] "" Vector__XXX
 SG_ S62PID6E_InjPresContrSys m110 : 39|8@0+ (1,0) [0|255] "" Vector__XXX
 SG_ S62PID6F_TurboComprPres m111 : 39|8@0+ (1,0) [0|255] "" Vector__XXX
 SG_ S62PID70_BoostPresCntrl m112 : 39|8@0+ (1,0) [0|255] "" Vector__XXX
 SG_ S62PID80_PIDsSupported_81_A0 m128 : 39|32@0+ (1,0) [0|4294967295] "" Vector__XXX
 SG_ S62PID8E_EngFrictionPctTorq m142 : 39|8@0+ (1,-125) [-125|130] "%" Vector__XXX
 SG_ S62PIDA0_PIDsSupported_A1_C0 m160 : 39|32@0+ (1,0) [0|4294967295] "" Vector__XXX
 SG_ S62PIDC0_PIDsSupported_C1_E0 m192 : 39|32@0+ (1,0) [0|4294967295] "" Vector__XXX
 SG_ S62PID m2M : 31|8@0+ (1,0) [0|255] "" Vector__XXX
 SG_ Service M : 11|4@0+ (1,0) [0|15] "" Vector__XXX
 SG_ Response : 15|4@0+ (1,0) [0|15] "" Vector__XXX
 SG_ Length : 7|8@0+ (1,0) [0|255] "" Vector__XXX

CM_ BO_ 2564485397 "OBD2 0xDA00";
BA_DEF_ SG_  "SignalIgnore" INT 0 1;
BA_DEF_ BO_  "VFrameFormat" ENUM  "StandardCAN","ExtendedCAN","StandardCAN_FD","ExtendedCAN_FD","J1939PG";
BA_DEF_  "BusType" STRING ;
BA_DEF_  "ProtocolType" STRING ;
BA_DEF_  "DatabaseCompiler" STRING ;
BA_DEF_DEF_  "SignalIgnore" 0;
BA_DEF_DEF_  "VFrameFormat" "";
BA_DEF_DEF_  "BusType" "";
BA_DEF_DEF_  "ProtocolType" "";
BA_DEF_DEF_  "DatabaseCompiler" "CSS Electronics (wwww.csselectronics.com)";
BA_ "BusType" "CAN";
BA_ "ProtocolType" "OBD";
BA_ "VFrameFormat" BO_ 2564485397 4;
BA_ "SignalIgnore" SG_ 2564485397 S62PID 1;
BA_ "SignalIgnore" SG_ 2564485397 Service 1;
BA_ "SignalIgnore" SG_ 2564485397 Response 1;
BA_ "SignalIgnore" SG_ 2564485397 Length 1;
VAL_ 2564485397 S62PID03_FuelSystemStatus 1 "Open loop (insuff. eng. temp.)" 2 "Closed loop (oxy sens)" 4 "Open loop (eng. load, fuel cut)" 8 "Open loop (system failure)" 16 "Closed loop (feedback issue)" ;
VAL_ 2564485397 S62PID12_CmdSecAirStatus 1 "Upstream" 2 "Downstream catalytic conv" 4 "From outside atmosphere/off" 8 "Pump cmd on for diagn." ;
VAL_ 2564485397 S62PID1C_OBDStandard 1 "OBD-II as defined by the CARB" 2 "OBD as defined by the EPA" 3 "OBD and OBD-II" 4 "OBD-I" 5 "Not OBD compliant" 6 "EOBD (Europe)" 7 "EOBD and OBD-II" 8 "EOBD and OBD" 9 "EOBD, OBD and OBD II" 10 "JOBD (Japan)" 11 "JOBD and OBD II" 12 "JOBD and EOBD" 13 "JOBD, EOBD, and OBD II" 14 "Reserved" 15 "Reserved" 16 "Reserved" 17 "Eng. Manu. Diag. (EMD)" 18 "EMD Enhanced (EMD+)" 19 "HD OBD-C" 20 "HD OBD" 21 "WWH OBD" 22 "Reserved" 23 "HD EOBD-I" 24 "HD EOBD-I N" 25 "HD EOBD-II" 26 "HD EOBD-II N" 27 "Reserved" 28 "OBDBr-1" 29 "OBDBr-2" 30 "KOBD" 31 "IOBD I" 32 "IOBD II" 33 "HD EOBD-IV" 34 "Reserved" 35 "Reserved" ;
VAL_ 2564485397 S62PID51_FuelType 0 "Not available" 1 "Gasoline" 2 "Methanol" 3 "Ethanol" 4 "Diesel" 5 "LPG" 6 "CNG" 7 "Propane" 8 "Electric" 9 "Bifuel running Gasoline" 10 "Bifuel running Methanol" 11 "Bifuel running Ethanol" 12 "Bifuel running LPG" 13 "Bifuel running CNG" 14 "Bifuel running Propane" 15 "Bifuel running Electricity" 16 "Bifuel electric/comb. eng." 17 "Hybrid gasoline" 18 "Hybrid Ethanol" 19 "Hybrid Diesel" 20 "Hybrid Electric" 21 "Hybrid running electric/comb." 22 "Hybrid Regenerative" 23 "Bifuel running diesel" ;
VAL_ 2564485397 S62PID 0 "S62PID00_PIDsSupported_01_20" 1 "S62PID01_MonitorStatus" 2 "S62PID02_FreezeDTC" 3 "S62PID03_FuelSystemStatus" 4 "S62PID04_CalcEngineLoad" 5 "S62PID05_EngineCoolantTemp" 6 "S62PID06_ShortFuelTrimBank1" 7 "S62PID07_LongFuelTrimBank1" 8 "S62PID08_ShortFuelTrimBank2" 9 "S62PID09_LongFuelTrimBank2" 10 "S62PID0A_FuelPressure" 11 "S62PID0B_IntakeManiAbsPress" 12 "S62PID0C_EngineRPM" 13 "S62PID0D_VehicleSpeed" 14 "S62PID0E_TimingAdvance" 15 "S62PID0F_IntakeAirTemperature" 16 "S62PID10_MAFAirFlowRate" 17 "S62PID11_ThrottlePosition" 18 "S62PID12_CmdSecAirStatus" 20 "S62PID14_OxySensor1" 21 "S62PID15_OxySensor2" 22 "S62PID16_OxySensor3" 23 "S62PID17_OxySensor4" 24 "S62PID18_OxySensor5" 25 "S62PID19_OxySensor6" 26 "S62PID1A_OxySensor7" 27 "S62PID1B_OxySensor8" 28 "S62PID1C_OBDStandard" 31 "S62PID1F_TimeSinceEngStart" 32 "S62PID20_PIDsSupported_21_40" 33 "S62PID21_DistanceMILOn" 34 "S62PID22_FuelRailPres" 35 "S62PID23_FuelRailGaug" 36 "S62PID24_OxySensor1" 37 "S62PID25_OxySensor2" 38 "S62PID26_OxySensor3" 39 "S62PID27_OxySensor4" 40 "S62PID28_OxySensor5" 41 "S62PID29_OxySensor6" 42 "S62PID2A_OxySensor7" 43 "S62PID2B_OxySensor8" 44 "S62PID2C_CmdEGR" 45 "S62PID2D_EGRError" 46 "S62PID2E_CmdEvapPurge" 47 "S62PID2F_FuelTankLevel" 48 "S62PID30_WarmUpsSinceCodeClear" 49 "S62PID31_DistanceSinceCodeClear" 50 "S62PID32_EvapSysVaporPres" 51 "S62PID33_AbsBaroPres" 52 "S62PID34_OxySensor1" 53 "S62PID35_OxySensor2" 54 "S62PID36_OxySensor3" 55 "S62PID37_OxySensor4" 56 "S62PID38_OxySensor5" 57 "S62PID39_OxySensor6" 58 "S62PID3A_OxySensor7" 59 "S62PID3B_OxySensor8" 60 "S62PID3C_CatTempBank1Sens1" 61 "S62PID3D_CatTempBank2Sens1" 62 "S62PID3E_CatTempBank1Sens2" 63 "S62PID3F_CatTempBank2Sens2" 64 "S62PID40_PIDsSupported_41_60" 65 "S62PID41_MonStatusDriveCycle" 66 "S62PID42_ControlModuleVolt" 67 "S62PID43_AbsLoadValue" 68 "S62PID44_FuelAirCmdEquiv" 69 "S62PID45_RelThrottlePos" 70 "S62PID46_AmbientAirTemp" 71 "S62PID47_AbsThrottlePosB" 72 "S62PID48_AbsThrottlePosC" 73 "S62PID49_AbsThrottlePosD" 74 "S62PID4A_AbsThrottlePosE" 75 "S62PID4B_AbsThrottlePosF" 76 "S62PID4C_CmdThrottleAct" 77 "S62PID4D_TimeRunMILOn" 78 "S62PID4E_TimeSinceCodeClear" 79 "S62PID4F_MaxMultiple" 80 "S62PID50_Max_AirFlowMAF" 81 "S62PID51_FuelType" 82 "S62PID52_EthanolFuelPct" 83 "S62PID53_AbsEvapSysVapPres" 84 "S62PID54_EvapSysVapPres" 85 "S62PID55_ShortSecOxyTrimBankX" 86 "S62PID56_LongSecOxyTrimBankX" 87 "S62PID57_ShortSecOxyTrimBankX" 88 "S62PID58_LongSecOxyTrimBankX" 89 "S62PID59_FuelRailAbsPres" 90 "S62PID5A_RelAccelPedalPos" 91 "S62PID5B_HybrBatPackRemLife" 92 "S62PID5C_EngineOilTemp" 93 "S62PID5D_FuelInjectionTiming" 94 "S62PID5E_EngineFuelRate" 95 "S62PID5F_EmissionReq" 96 "S62PID60_PIDsSupported_61_80" 97 "S62PID61_DemandEngTorqPct" 98 "S62PID62_ActualEngTorqPct" 99 "S62PID63_EngRefTorq" 101 "S62PID65_AuxInputOutput" 102 "S62PID66_MAFSensor" 103 "S62PID67_EngineCoolantTemp" 104 "S62PID68_IntakeAirTempSens" 105 "S62PID69_CmdEGR_EGRError" 106 "S62PID6A_CmdDieselIntAir" 107 "S62PID6B_ExhaustGasTemp" 108 "S62PID6C_CmdThrottleActRel" 109 "S62PID6D_FuelPresContrSys" 110 "S62PID6E_InjPresContrSys" 111 "S62PID6F_TurboComprPres" 112 "S62PID70_BoostPresCntrl" 128 "S62PID80_PIDsSupported_81_A0" 142 "S62PID8E_EngFrictionPctTorq" 160 "S62PIDA0_PIDsSupported_A1_C0" 192 "S62PIDC0_PIDsSupported_C1_E0" ;
VAL_ 2564485397 Service 10 "Permanent DTCs (Cleared DTCs) " 9 "Request vehicle information " 8 "Control on-board system " 7 "Show pending DTCs " 6 "Other system monitoring " 5 "Oxygen sensor monitoring " 4 "Clear DTCs and stored values" 3 "Show stored DTCs " 2 "Show freeze frame data " 1 "Show current data " ;

SG_MUL_VAL_ 2564485397 S62PID00_PIDsSupported_01_20 S62PID 0-0;
SG_MUL_VAL_ 2564485397 S62PID01_MonitorStatus S62PID 1-1;
SG_MUL_VAL_ 2564485397 S62PID02_FreezeDTC S62PID 2-2;
SG_MUL_VAL_ 2564485397 S62PID03_FuelSystemStatus S62PID 3-3;
SG_MUL_VAL_ 2564485397 S62PID04_CalcEngineLoad S62PID 4-4;
SG_MUL_VAL_ 2564485397 S62PID05_EngineCoolantTemp S62PID 5-5;
SG_MUL_VAL_ 2564485397 S62PID06_ShortFuelTrimBank1 S62PID 6-6;
SG_MUL_VAL_ 2564485397 S62PID07_LongFuelTrimBank1 S62PID 7-7;
SG_MUL_VAL_ 2564485397 S62PID08_ShortFuelTrimBank2 S62PID 8-8;
SG_MUL_VAL_ 2564485397 S62PID09_LongFuelTrimBank2 S62PID 9-9;
SG_MUL_VAL_ 2564485397 S62PID0A_FuelPressure S62PID 10-10;
SG_MUL_VAL_ 2564485397 S62PID0B_IntakeManiAbsPress S62PID 11-11;
SG_MUL_VAL_ 2564485397 S62PID0C_EngineRPM S62PID 12-12;
SG_MUL_VAL_ 2564485397 S62PID0D_VehicleSpeed S62PID 13-13;
SG_MUL_VAL_ 2564485397 S62PID0E_TimingAdvance S62PID 14-14;
SG_MUL_VAL_ 2564485397 S62PID0F_IntakeAirTemperature S62PID 15-15;
SG_MUL_VAL_ 2564485397 S62PID10_MAFAirFlowRate S62PID 16-16;
SG_MUL_VAL_ 2564485397 S62PID11_ThrottlePosition S62PID 17-17;
SG_MUL_VAL_ 2564485397 S62PID12_CmdSecAirStatus S62PID 18-18;
SG_MUL_VAL_ 2564485397 S62PID14_OxySensor1_Volt S62PID 20-20;
SG_MUL_VAL_ 2564485397 S62PID14_OxySensor1_STFT S62PID 20-20;
SG_MUL_VAL_ 2564485397 S62PID15_OxySensor2_Volt S62PID 21-21;
SG_MUL_VAL_ 2564485397 S62PID15_OxySensor2_STFT S62PID 21-21;
SG_MUL_VAL_ 2564485397 S62PID16_OxySensor3_Volt S62PID 22-22;
SG_MUL_VAL_ 2564485397 S62PID16_OxySensor3_STFT S62PID 22-22;
SG_MUL_VAL_ 2564485397 S62PID17_OxySensor4_Volt S62PID 23-23;
SG_MUL_VAL_ 2564485397 S62PID17_OxySensor4_STFT S62PID 23-23;
SG_MUL_VAL_ 2564485397 S62PID18_OxySensor5_Volt S62PID 24-24;
SG_MUL_VAL_ 2564485397 S62PID18_OxySensor5_STFT S62PID 24-24;
SG_MUL_VAL_ 2564485397 S62PID19_OxySensor6_Volt S62PID 25-25;
SG_MUL_VAL_ 2564485397 S62PID19_OxySensor6_STFT S62PID 25-25;
SG_MUL_VAL_ 2564485397 S62PID1A_OxySensor7_Volt S62PID 26-26;
SG_MUL_VAL_ 2564485397 S62PID1A_OxySensor7_STFT S62PID 26-26;
SG_MUL_VAL_ 2564485397 S62PID1B_OxySensor8_Volt S62PID 27-27;
SG_MUL_VAL_ 2564485397 S62PID1B_OxySensor8_STFT S62PID 27-27;
SG_MUL_VAL_ 2564485397 S62PID1C_OBDStandard S62PID 28-28;
SG_MUL_VAL_ 2564485397 S62PID1F_TimeSinceEngStart S62PID 31-31;
SG_MUL_VAL_ 2564485397 S62PID20_PIDsSupported_21_40 S62PID 32-32;
SG_MUL_VAL_ 2564485397 S62PID21_DistanceMILOn S62PID 33-33;
SG_MUL_VAL_ 2564485397 S62PID22_FuelRailPres S62PID 34-34;
SG_MUL_VAL_ 2564485397 S62PID23_FuelRailGaug S62PID 35-35;
SG_MUL_VAL_ 2564485397 S62PID24_OxySensor1_FAER S62PID 36-36;
SG_MUL_VAL_ 2564485397 S62PID24_OxySensor1_Volt S62PID 36-36;
SG_MUL_VAL_ 2564485397 S62PID25_OxySensor2_FAER S62PID 37-37;
SG_MUL_VAL_ 2564485397 S62PID25_OxySensor2_Volt S62PID 37-37;
SG_MUL_VAL_ 2564485397 S62PID26_OxySensor3_FAER S62PID 38-38;
SG_MUL_VAL_ 2564485397 S62PID26_OxySensor3_Volt S62PID 38-38;
SG_MUL_VAL_ 2564485397 S62PID27_OxySensor4_FAER S62PID 39-39;
SG_MUL_VAL_ 2564485397 S62PID27_OxySensor4_Volt S62PID 39-39;
SG_MUL_VAL_ 2564485397 S62PID28_OxySensor5_FAER S62PID 40-40;
SG_MUL_VAL_ 2564485397 S62PID28_OxySensor5_Volt S62PID 40-40;
SG_MUL_VAL_ 2564485397 S62PID29_OxySensor6_FAER S62PID 41-41;
SG_MUL_VAL_ 2564485397 S62PID29_OxySensor6_Volt S62PID 41-41;
SG_MUL_VAL_ 2564485397 S62PID2A_OxySensor7_FAER S62PID 42-42;
SG_MUL_VAL_ 2564485397 S62PID2A_OxySensor7_Volt S62PID 42-42;
SG_MUL_VAL_ 2564485397 S62PID2B_OxySensor8_FAER S62PID 43-43;
SG_MUL_VAL_ 2564485397 S62PID2B_OxySensor8_Volt S62PID 43-43;
SG_MUL_VAL_ 2564485397 S62PID2C_CmdEGR S62PID 44-44;
SG_MUL_VAL_ 2564485397 S62PID2D_EGRError S62PID 45-45;
SG_MUL_VAL_ 2564485397 S62PID2E_CmdEvapPurge S62PID 46-46;
SG_MUL_VAL_ 2564485397 S62PID2F_FuelTankLevel S62PID 47-47;
SG_MUL_VAL_ 2564485397 S62PID30_WarmUpsSinceCodeClear S62PID 48-48;
SG_MUL_VAL_ 2564485397 S62PID31_DistanceSinceCodeClear S62PID 49-49;
SG_MUL_VAL_ 2564485397 S62PID32_EvapSysVaporPres S62PID 50-50;
SG_MUL_VAL_ 2564485397 S62PID33_AbsBaroPres S62PID 51-51;
SG_MUL_VAL_ 2564485397 S62PID34_OxySensor1_FAER S62PID 52-52;
SG_MUL_VAL_ 2564485397 S62PID34_OxySensor1_Crnt S62PID 52-52;
SG_MUL_VAL_ 2564485397 S62PID35_OxySensor2_FAER S62PID 53-53;
SG_MUL_VAL_ 2564485397 S62PID35_OxySensor2_Crnt S62PID 53-53;
SG_MUL_VAL_ 2564485397 S62PID36_OxySensor3_FAER S62PID 54-54;
SG_MUL_VAL_ 2564485397 S62PID36_OxySensor3_Crnt S62PID 54-54;
SG_MUL_VAL_ 2564485397 S62PID37_OxySensor4_FAER S62PID 55-55;
SG_MUL_VAL_ 2564485397 S62PID37_OxySensor4_Crnt S62PID 55-55;
SG_MUL_VAL_ 2564485397 S62PID38_OxySensor5_FAER S62PID 56-56;
SG_MUL_VAL_ 2564485397 S62PID38_OxySensor5_Crnt S62PID 56-56;
SG_MUL_VAL_ 2564485397 S62PID39_OxySensor6_FAER S62PID 57-57;
SG_MUL_VAL_ 2564485397 S62PID39_OxySensor6_Crnt S62PID 57-57;
SG_MUL_VAL_ 2564485397 S62PID3A_OxySensor7_FAER S62PID 58-58;
SG_MUL_VAL_ 2564485397 S62PID3A_OxySensor7_Crnt S62PID 58-58;
SG_MUL_VAL_ 2564485397 S62PID3B_OxySensor8_FAER S62PID 59-59;
SG_MUL_VAL_ 2564485397 S62PID3B_OxySensor8_Crnt S62PID 59-59;
SG_MUL_VAL_ 2564485397 S62PID3C_CatTempBank1Sens1 S62PID 60-60;
SG_MUL_VAL_ 2564485397 S62PID3D_CatTempBank2Sens1 S62PID 61-61;
SG_MUL_VAL_ 2564485397 S62PID3E_CatTempBank1Sens2 S62PID 62-62;
SG_MUL_VAL_ 2564485397 S62PID3F_CatTempBank2Sens2 S62PID 63-63;
SG_MUL_VAL_ 2564485397 S62PID40_PIDsSupported_41_60 S62PID 64-64;
SG_MUL_VAL_ 2564485397 S62PID41_MonStatusDriveCycle S62PID 65-65;
SG_MUL_VAL_ 2564485397 S62PID42_ControlModuleVolt S62PID 66-66;
SG_MUL_VAL_ 2564485397 S62PID43_AbsLoadValue S62PID 67-67;
SG_MUL_VAL_ 2564485397 S62PID44_FuelAirCmdEquiv S62PID 68-68;
SG_MUL_VAL_ 2564485397 S62PID45_RelThrottlePos S62PID 69-69;
SG_MUL_VAL_ 2564485397 S62PID46_AmbientAirTemp S62PID 70-70;
SG_MUL_VAL_ 2564485397 S62PID47_AbsThrottlePosB S62PID 71-71;
SG_MUL_VAL_ 2564485397 S62PID48_AbsThrottlePosC S62PID 72-72;
SG_MUL_VAL_ 2564485397 S62PID49_AbsThrottlePosD S62PID 73-73;
SG_MUL_VAL_ 2564485397 S62PID4A_AbsThrottlePosE S62PID 74-74;
SG_MUL_VAL_ 2564485397 S62PID4B_AbsThrottlePosF S62PID 75-75;
SG_MUL_VAL_ 2564485397 S62PID4C_CmdThrottleAct S62PID 76-76;
SG_MUL_VAL_ 2564485397 S62PID4D_TimeRunMILOn S62PID 77-77;
SG_MUL_VAL_ 2564485397 S62PID4E_TimeSinceCodeClear S62PID 78-78;
SG_MUL_VAL_ 2564485397 S62PID4F_Max_FAER S62PID 79-79;
SG_MUL_VAL_ 2564485397 S62PID4F_Max_OxySensVol S62PID 79-79;
SG_MUL_VAL_ 2564485397 S62PID4F_Max_OxySensCrnt S62PID 79-79;
SG_MUL_VAL_ 2564485397 S62PID4F_Max_IntManiAbsPres S62PID 79-79;
SG_MUL_VAL_ 2564485397 S62PID50_Max_AirFlowMAF S62PID 80-80;
SG_MUL_VAL_ 2564485397 S62PID51_FuelType S62PID 81-81;
SG_MUL_VAL_ 2564485397 S62PID52_EthanolFuelPct S62PID 82-82;
SG_MUL_VAL_ 2564485397 S62PID53_AbsEvapSysVapPres S62PID 83-83;
SG_MUL_VAL_ 2564485397 S62PID54_EvapSysVapPres S62PID 84-84;
SG_MUL_VAL_ 2564485397 S62PID55_ShortSecOxyTrimBank1 S62PID 85-85;
SG_MUL_VAL_ 2564485397 S62PID55_ShortSecOxyTrimBank3 S62PID 85-85;
SG_MUL_VAL_ 2564485397 S62PID56_LongSecOxyTrimBank1 S62PID 86-86;
SG_MUL_VAL_ 2564485397 S62PID56_LongSecOxyTrimBank3 S62PID 86-86;
SG_MUL_VAL_ 2564485397 S62PID57_ShortSecOxyTrimBank2 S62PID 87-87;
SG_MUL_VAL_ 2564485397 S62PID57_ShortSecOxyTrimBank4 S62PID 87-87;
SG_MUL_VAL_ 2564485397 S62PID58_LongSecOxyTrimBank2 S62PID 88-88;
SG_MUL_VAL_ 2564485397 S62PID58_LongSecOxyTrimBank4 S62PID 88-88;
SG_MUL_VAL_ 2564485397 S62PID59_FuelRailAbsPres S62PID 89-89;
SG_MUL_VAL_ 2564485397 S62PID5A_RelAccelPedalPos S62PID 90-90;
SG_MUL_VAL_ 2564485397 S62PID5B_HybrBatPackRemLife S62PID 91-91;
SG_MUL_VAL_ 2564485397 S62PID5C_EngineOilTemp S62PID 92-92;
SG_MUL_VAL_ 2564485397 S62PID5D_FuelInjectionTiming S62PID 93-93;
SG_MUL_VAL_ 2564485397 S62PID5E_EngineFuelRate S62PID 94-94;
SG_MUL_VAL_ 2564485397 S62PID5F_EmissionReq S62PID 95-95;
SG_MUL_VAL_ 2564485397 S62PID60_PIDsSupported_61_80 S62PID 96-96;
SG_MUL_VAL_ 2564485397 S62PID61_DemandEngTorqPct S62PID 97-97;
SG_MUL_VAL_ 2564485397 S62PID62_ActualEngTorqPct S62PID 98-98;
SG_MUL_VAL_ 2564485397 S62PID63_EngRefTorq S62PID 99-99;
SG_MUL_VAL_ 2564485397 S62PID65_AuxInputOutput S62PID 101-101;
SG_MUL_VAL_ 2564485397 S62PID66_MAFSensor S62PID 102-102;
SG_MUL_VAL_ 2564485397 S62PID67_EngineCoolantTemp S62PID 103-103;
SG_MUL_VAL_ 2564485397 S62PID68_IntakeAirTempSens S62PID 104-104;
SG_MUL_VAL_ 2564485397 S62PID69_CmdEGR_EGRError S62PID 105-105;
SG_MUL_VAL_ 2564485397 S62PID6A_CmdDieselIntAir S62PID 106-106;
SG_MUL_VAL_ 2564485397 S62PID6B_ExhaustGasTemp S62PID 107-107;
SG_MUL_VAL_ 2564485397 S62PID6C_CmdThrottleActRel S62PID 108-108;
SG_MUL_VAL_ 2564485397 S62PID6D_FuelPresContrSys S62PID 109-109;
SG_MUL_VAL_ 2564485397 S62PID6E_InjPresContrSys S62PID 110-110;
SG_MUL_VAL_ 2564485397 S62PID6F_TurboComprPres S62PID 111-111;
SG_MUL_VAL_ 2564485397 S62PID70_BoostPresCntrl S62PID 112-112;
SG_MUL_VAL_ 2564485397 S62PID80_PIDsSupported_81_A0 S62PID 128-128;
SG_MUL_VAL_ 2564485397 S62PID8E_EngFrictionPctTorq S62PID 142-142;
SG_MUL_VAL_ 2564485397 S62PIDA0_PIDsSupported_A1_C0 S62PID 160-160;
SG_MUL_VAL_ 2564485397 S62PIDC0_PIDsSupported_C1_E0 S62PID 192-192;
SG_MUL_VAL_ 2564485397 S62PID Service 2-2;
