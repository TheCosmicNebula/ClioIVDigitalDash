VERSION ""

NS_ :

BS_:

BU_:

BO_ 2564485397 OBD2: 8 Vector__XXX
 SG_ S01PID00_PIDsSupported_01_20 m0 : 31|32@0+ (1,0) [0|4294967295] "" Vector__XXX
 SG_ S01PID01_MonitorStatus m1 : 31|32@0+ (1,0) [0|4294967295] "" Vector__XXX
 SG_ S01PID02_FreezeDTC m2 : 31|16@0+ (1,0) [0|65535] "" Vector__XXX
 SG_ S01PID03_FuelSystemStatus m3 : 31|16@0+ (1,0) [0|65535] "" Vector__XXX
 SG_ S01PID04_CalcEngineLoad m4 : 31|8@0+ (0.39216,0) [0|100] "%" Vector__XXX
 SG_ S01PID05_EngineCoolantTemp m5 : 31|8@0+ (1,-40) [-40|215] "degC" Vector__XXX
 SG_ S01PID06_ShortFuelTrimBank1 m6 : 31|8@0+ (0.78125,-100) [-100|99.21875] "%" Vector__XXX
 SG_ S01PID07_LongFuelTrimBank1 m7 : 31|8@0+ (0.78125,-100) [-100|99.21875] "%" Vector__XXX
 SG_ S01PID08_ShortFuelTrimBank2 m8 : 31|8@0+ (0.78125,-100) [-100|99.21875] "%" Vector__XXX
 SG_ S01PID09_LongFuelTrimBank2 m9 : 31|8@0+ (0.78125,-100) [-100|99.21875] "%" Vector__XXX
 SG_ S01PID0A_FuelPressure m10 : 31|8@0+ (3,0) [0|765] "kPa" Vector__XXX
 SG_ S01PID0B_IntakeManiAbsPress m11 : 31|8@0+ (1,0) [0|255] "kPa" Vector__XXX
 SG_ S01PID0C_EngineRPM m12 : 31|16@0+ (0.25,0) [0|16383.75] "rpm" Vector__XXX
 SG_ S01PID0D_VehicleSpeed m13 : 31|8@0+ (1,0) [0|255] "km/h" Vector__XXX
 SG_ S01PID0E_TimingAdvance m14 : 31|8@0+ (0.5,-64) [-64|63.5] "deg before TDC" Vector__XXX
 SG_ S01PID0F_IntakeAirTemperature m15 : 31|8@0+ (1,-40) [-40|215] "degC" Vector__XXX
 SG_ S01PID10_MAFAirFlowRate m16 : 31|16@0+ (0.01,0) [0|655.35] "grams/sec" Vector__XXX
 SG_ S01PID11_ThrottlePosition m17 : 31|8@0+ (0.39216,0) [0|100] "%" Vector__XXX
 SG_ S01PID12_CmdSecAirStatus m18 : 31|8@0+ (1,0) [0|255] "" Vector__XXX
 SG_ S01PID14_OxySensor1_Volt m20 : 31|8@0+ (0.005,0) [0|1.275] "volts" Vector__XXX
 SG_ S01PID14_OxySensor1_STFT m20 : 39|8@0+ (0.78125,-100) [-100|99.21875] "%" Vector__XXX
 SG_ S01PID15_OxySensor2_Volt m21 : 31|8@0+ (0.005,0) [0|1.275] "volts" Vector__XXX
 SG_ S01PID15_OxySensor2_STFT m21 : 39|8@0+ (0.78125,-100) [-100|99.21875] "%" Vector__XXX
 SG_ S01PID16_OxySensor3_Volt m22 : 31|8@0+ (0.005,0) [0|1.275] "volts" Vector__XXX
 SG_ S01PID16_OxySensor3_STFT m22 : 39|8@0+ (0.78125,-100) [-100|99.21875] "%" Vector__XXX
 SG_ S01PID17_OxySensor4_Volt m23 : 31|8@0+ (0.005,0) [0|1.275] "volts" Vector__XXX
 SG_ S01PID17_OxySensor4_STFT m23 : 39|8@0+ (0.78125,-100) [-100|99.21875] "%" Vector__XXX
 SG_ S01PID18_OxySensor5_Volt m24 : 31|8@0+ (0.005,0) [0|1.275] "volts" Vector__XXX
 SG_ S01PID18_OxySensor5_STFT m24 : 39|8@0+ (0.78125,-100) [-100|99.21875] "%" Vector__XXX
 SG_ S01PID19_OxySensor6_Volt m25 : 31|8@0+ (0.005,0) [0|1.275] "volts" Vector__XXX
 SG_ S01PID19_OxySensor6_STFT m25 : 39|8@0+ (0.78125,-100) [-100|99.21875] "%" Vector__XXX
 SG_ S01PID1A_OxySensor7_Volt m26 : 31|8@0+ (0.005,0) [0|1.275] "volts" Vector__XXX
 SG_ S01PID1A_OxySensor7_STFT m26 : 39|8@0+ (0.78125,-100) [-100|99.21875] "%" Vector__XXX
 SG_ S01PID1B_OxySensor8_Volt m27 : 31|8@0+ (0.005,0) [0|1.275] "volts" Vector__XXX
 SG_ S01PID1B_OxySensor8_STFT m27 : 39|8@0+ (0.78125,-100) [-100|99.21875] "%" Vector__XXX
 SG_ S01PID1C_OBDStandard m28 : 31|8@0+ (1,0) [0|255] "" Vector__XXX
 SG_ S01PID1F_TimeSinceEngStart m31 : 31|16@0+ (1,0) [0|65535] "seconds" Vector__XXX
 SG_ S01PID20_PIDsSupported_21_40 m32 : 31|32@0+ (1,0) [0|4294967295] "" Vector__XXX
 SG_ S01PID21_DistanceMILOn m33 : 31|16@0+ (1,0) [0|65535] "km" Vector__XXX
 SG_ S01PID22_FuelRailPres m34 : 31|16@0+ (0.079,0) [0|5177.265] "kPa" Vector__XXX
 SG_ S01PID23_FuelRailGaug m35 : 31|16@0+ (10,0) [0|655350] "kPa" Vector__XXX
 SG_ S01PID24_OxySensor1_FAER m36 : 31|16@0+ (3.0517578125E-005,0) [0|2] "ratio" Vector__XXX
 SG_ S01PID24_OxySensor1_Volt m36 : 47|16@0+ (0.0001220703125,0) [0|2] "volts" Vector__XXX
 SG_ S01PID25_OxySensor2_FAER m37 : 31|16@0+ (3.0517578125E-005,0) [0|2] "ratio" Vector__XXX
 SG_ S01PID25_OxySensor2_Volt m37 : 47|16@0+ (0.0001220703125,0) [0|8] "volts" Vector__XXX
 SG_ S01PID26_OxySensor3_FAER m38 : 31|16@0+ (3.0517578125E-005,0) [0|2] "ratio" Vector__XXX
 SG_ S01PID26_OxySensor3_Volt m38 : 47|16@0+ (0.0001220703125,0) [0|8] "volts" Vector__XXX
 SG_ S01PID27_OxySensor4_FAER m39 : 31|16@0+ (3.0517578125E-005,0) [0|2] "ratio" Vector__XXX
 SG_ S01PID27_OxySensor4_Volt m39 : 47|16@0+ (0.0001220703125,0) [0|8] "volts" Vector__XXX
 SG_ S01PID28_OxySensor5_FAER m40 : 31|16@0+ (3.0517578125E-005,0) [0|2] "ratio" Vector__XXX
 SG_ S01PID28_OxySensor5_Volt m40 : 47|16@0+ (0.0001220703125,0) [0|8] "volts" Vector__XXX
 SG_ S01PID29_OxySensor6_FAER m41 : 31|16@0+ (3.0517578125E-005,0) [0|2] "ratio" Vector__XXX
 SG_ S01PID29_OxySensor6_Volt m41 : 47|16@0+ (0.0001220703125,0) [0|8] "volts" Vector__XXX
 SG_ S01PID2A_OxySensor7_FAER m42 : 31|16@0+ (3.0517578125E-005,0) [0|2] "ratio" Vector__XXX
 SG_ S01PID2A_OxySensor7_Volt m42 : 47|16@0+ (0.0001220703125,0) [0|8] "volts" Vector__XXX
 SG_ S01PID2B_OxySensor8_FAER m43 : 31|16@0+ (3.0517578125E-005,0) [0|2] "ratio" Vector__XXX
 SG_ S01PID2B_OxySensor8_Volt m43 : 47|16@0+ (0.0001220703125,0) [0|8] "volts" Vector__XXX
 SG_ S01PID2C_CmdEGR m44 : 31|8@0+ (0.392156862745098,0) [0|100] "%" Vector__XXX
 SG_ S01PID2D_EGRError m45 : 31|8@0+ (0.78125,-100) [-100|99.21875] "%" Vector__XXX
 SG_ S01PID2E_CmdEvapPurge m46 : 31|8@0+ (0.392156862745098,0) [0|100] "%" Vector__XXX
 SG_ S01PID2F_FuelTankLevel m47 : 31|8@0+ (0.392156862745098,0) [0|100] "%" Vector__XXX
 SG_ S01PID30_WarmUpsSinceCodeClear m48 : 31|8@0+ (1,0) [0|255] "count" Vector__XXX
 SG_ S01PID31_DistanceSinceCodeClear m49 : 31|16@0+ (1,0) [0|65535] "km" Vector__XXX
 SG_ S01PID32_EvapSysVaporPres m50 : 31|16@0- (0.25,0) [-8192|8191.75] "Pa" Vector__XXX
 SG_ S01PID33_AbsBaroPres m51 : 31|8@0+ (1,0) [0|255] "kPa" Vector__XXX
 SG_ S01PID34_OxySensor1_FAER m52 : 31|16@0+ (3.0517578125E-005,0) [0|2] "ratio" Vector__XXX
 SG_ S01PID34_OxySensor1_Crnt m52 : 47|16@0+ (0.00390625,-128) [-128|128] "mA" Vector__XXX
 SG_ S01PID35_OxySensor2_FAER m53 : 31|16@0+ (3.0517578125E-005,0) [0|2] "ratio" Vector__XXX
 SG_ S01PID35_OxySensor2_Crnt m53 : 47|16@0+ (0.00390625,-128) [-128|128] "mA" Vector__XXX
 SG_ S01PID36_OxySensor3_FAER m54 : 31|16@0+ (3.0517578125E-005,0) [0|2] "ratio" Vector__XXX
 SG_ S01PID36_OxySensor3_Crnt m54 : 47|16@0+ (0.00390625,-128) [-128|128] "mA" Vector__XXX
 SG_ S01PID37_OxySensor4_FAER m55 : 31|16@0+ (3.0517578125E-005,0) [0|2] "ratio" Vector__XXX
 SG_ S01PID37_OxySensor4_Crnt m55 : 47|16@0+ (0.00390625,-128) [-128|128] "mA" Vector__XXX
 SG_ S01PID38_OxySensor5_FAER m56 : 31|16@0+ (3.0517578125E-005,0) [0|2] "ratio" Vector__XXX
 SG_ S01PID38_OxySensor5_Crnt m56 : 47|16@0+ (0.00390625,-128) [-128|128] "mA" Vector__XXX
 SG_ S01PID39_OxySensor6_FAER m57 : 31|16@0+ (3.0517578125E-005,0) [0|2] "ratio" Vector__XXX
 SG_ S01PID39_OxySensor6_Crnt m57 : 47|16@0+ (0.00390625,-128) [-128|128] "mA" Vector__XXX
 SG_ S01PID3A_OxySensor7_FAER m58 : 31|16@0+ (3.0517578125E-005,0) [0|2] "ratio" Vector__XXX
 SG_ S01PID3A_OxySensor7_Crnt m58 : 47|16@0+ (0.00390625,-128) [-128|128] "mA" Vector__XXX
 SG_ S01PID3B_OxySensor8_FAER m59 : 31|16@0+ (3.0517578125E-005,0) [0|2] "ratio" Vector__XXX
 SG_ S01PID3B_OxySensor8_Crnt m59 : 47|16@0+ (0.00390625,-128) [-128|128] "mA" Vector__XXX
 SG_ S01PID3C_CatTempBank1Sens1 m60 : 31|16@0+ (0.1,-40) [-40|6513.5] "degC" Vector__XXX
 SG_ S01PID3D_CatTempBank2Sens1 m61 : 31|16@0+ (0.1,-40) [-40|6513.5] "degC" Vector__XXX
 SG_ S01PID3E_CatTempBank1Sens2 m62 : 31|16@0+ (0.1,-40) [-40|6513.5] "degC" Vector__XXX
 SG_ S01PID3F_CatTempBank2Sens2 m63 : 31|16@0+ (0.1,-40) [-40|6513.5] "degC" Vector__XXX
 SG_ S01PID40_PIDsSupported_41_60 m64 : 31|32@0+ (1,0) [0|4294967295] "" Vector__XXX
 SG_ S01PID41_MonStatusDriveCycle m65 : 31|32@0+ (1,0) [0|4294967295] "" Vector__XXX
 SG_ S01PID42_ControlModuleVolt m66 : 31|16@0+ (0.001,0) [0|65.535] "V" Vector__XXX
 SG_ S01PID43_AbsLoadValue m67 : 31|16@0+ (0.392156862745098,0) [0|25700] "%" Vector__XXX
 SG_ S01PID44_FuelAirCmdEquiv m68 : 31|16@0+ (3.0517578125E-005,0) [0|2] "ratio" Vector__XXX
 SG_ S01PID45_RelThrottlePos m69 : 31|8@0+ (0.392156862745098,0) [0|100] "%" Vector__XXX
 SG_ S01PID46_AmbientAirTemp m70 : 31|8@0+ (1,-40) [-40|215] "degC" Vector__XXX
 SG_ S01PID47_AbsThrottlePosB m71 : 31|8@0+ (0.392156862745098,0) [0|100] "%" Vector__XXX
 SG_ S01PID48_AbsThrottlePosC m72 : 31|8@0+ (0.392156862745098,0) [0|100] "%" Vector__XXX
 SG_ S01PID49_AbsThrottlePosD m73 : 31|8@0+ (0.392156862745098,0) [0|100] "%" Vector__XXX
 SG_ S01PID4A_AbsThrottlePosE m74 : 31|8@0+ (0.392156862745098,0) [0|100] "%" Vector__XXX
 SG_ S01PID4B_AbsThrottlePosF m75 : 31|8@0+ (0.392156862745098,0) [0|100] "%" Vector__XXX
 SG_ S01PID4C_CmdThrottleAct m76 : 31|8@0+ (0.392156862745098,0) [0|100] "%" Vector__XXX
 SG_ S01PID4D_TimeRunMILOn m77 : 31|16@0+ (1,0) [0|65535] "minutes" Vector__XXX
 SG_ S01PID4E_TimeSinceCodeClear m78 : 31|16@0+ (1,0) [0|65535] "minutes" Vector__XXX
 SG_ S01PID4F_Max_FAER m79 : 31|8@0+ (1,0) [0|255] "ratio" Vector__XXX
 SG_ S01PID4F_Max_OxySensVol m79 : 39|8@0+ (1,0) [0|255] "V" Vector__XXX
 SG_ S01PID4F_Max_OxySensCrnt m79 : 47|8@0+ (1,0) [0|255] "mA" Vector__XXX
 SG_ S01PID4F_Max_IntManiAbsPres m79 : 55|8@0+ (10,0) [0|2550] "kPa" Vector__XXX
 SG_ S01PID50_Max_AirFlowMAF m80 : 31|8@0+ (10,0) [0|2550] "g/s" Vector__XXX
 SG_ S01PID51_FuelType m81 : 31|8@0+ (1,0) [0|255] "" Vector__XXX
 SG_ S01PID52_EthanolFuelPct m82 : 31|8@0+ (0.392156862745098,0) [0|100] "%" Vector__XXX
 SG_ S01PID53_AbsEvapSysVapPres m83 : 31|16@0+ (0.005,0) [0|327.675] "kPa" Vector__XXX
 SG_ S01PID54_EvapSysVapPres m84 : 31|16@0+ (1,-32767) [-32767|32768] "Pa" Vector__XXX
 SG_ S01PID55_ShortSecOxyTrimBank1 m85 : 31|8@0+ (0.78125,-100) [-100|99.21875] "%" Vector__XXX
 SG_ S01PID55_ShortSecOxyTrimBank3 m85 : 39|8@0+ (0.78125,-100) [-100|99.21875] "%" Vector__XXX
 SG_ S01PID56_LongSecOxyTrimBank1 m86 : 31|8@0+ (0.78125,-100) [-100|99.21875] "%" Vector__XXX
 SG_ S01PID56_LongSecOxyTrimBank3 m86 : 39|8@0+ (0.78125,-100) [-100|99.21875] "%" Vector__XXX
 SG_ S01PID57_ShortSecOxyTrimBank2 m87 : 31|8@0+ (0.78125,-100) [-100|99.21875] "%" Vector__XXX
 SG_ S01PID57_ShortSecOxyTrimBank4 m87 : 39|8@0+ (0.78125,-100) [-100|99.21875] "%" Vector__XXX
 SG_ S01PID58_LongSecOxyTrimBank2 m88 : 31|8@0+ (0.78125,-100) [-100|99.21875] "%" Vector__XXX
 SG_ S01PID58_LongSecOxyTrimBank4 m88 : 39|8@0+ (0.78125,-100) [-100|99.21875] "%" Vector__XXX
 SG_ S01PID59_FuelRailAbsPres m89 : 31|16@0+ (10,0) [0|655350] "kPa" Vector__XXX
 SG_ S01PID5A_RelAccelPedalPos m90 : 31|8@0+ (0.392156862745098,0) [0|100] "%" Vector__XXX
 SG_ S01PID5B_HybrBatPackRemLife m91 : 31|8@0+ (0.392156862745098,0) [0|100] "%" Vector__XXX
 SG_ S01PID5C_EngineOilTemp m92 : 31|8@0+ (1,-40) [-40|215] "degC" Vector__XXX
 SG_ S01PID5D_FuelInjectionTiming m93 : 31|16@0+ (0.0078125,-210) [-210|301.9921875] "deg" Vector__XXX
 SG_ S01PID5E_EngineFuelRate m94 : 31|16@0+ (0.05,0) [0|3276.75] "L/h" Vector__XXX
 SG_ S01PID5F_EmissionReq m95 : 31|8@0+ (1,0) [0|255] "" Vector__XXX
 SG_ S01PID60_PIDsSupported_61_80 m96 : 31|32@0+ (1,0) [0|4294967295] "" Vector__XXX
 SG_ S01PID61_DemandEngTorqPct m97 : 31|8@0+ (1,-125) [-125|130] "%" Vector__XXX
 SG_ S01PID62_ActualEngTorqPct m98 : 31|8@0+ (1,-125) [-125|130] "%" Vector__XXX
 SG_ S01PID63_EngRefTorq m99 : 31|16@0+ (1,0) [0|65535] "Nm" Vector__XXX
 SG_ S01PID64_EngPctTorq_Idle m100 : 31|8@0+ (1,-125) [-125|130] "%" Vector__XXX
 SG_ S01PID64_EngPctTorq_EP1 m100 : 39|8@0+ (1,-125) [-125|130] "%" Vector__XXX
 SG_ S01PID64_EngPctTorq_EP2 m100 : 47|8@0+ (1,-125) [-125|130] "%" Vector__XXX
 SG_ S01PID64_EngPctTorq_EP3 m100 : 55|8@0+ (1,-125) [-125|130] "%" Vector__XXX
 SG_ S01PID64_EngPctTorq_EP4 m100 : 63|8@0+ (1,-125) [-125|130] "%" Vector__XXX
 SG_ S01PID65_AuxInputOutput m101 : 31|8@0+ (1,0) [0|255] "" Vector__XXX
 SG_ S01PID66_MAFSensor m102 : 31|8@0+ (1,0) [0|255] "" Vector__XXX
 SG_ S01PID67_EngineCoolantTemp m103 : 31|8@0+ (1,0) [0|255] "" Vector__XXX
 SG_ S01PID68_IntakeAirTempSens m104 : 31|8@0+ (1,0) [0|255] "" Vector__XXX
 SG_ S01PID69_CmdEGR_EGRError m105 : 31|8@0+ (1,0) [0|255] "" Vector__XXX
 SG_ S01PID6A_CmdDieselIntAir m106 : 31|8@0+ (1,0) [0|255] "" Vector__XXX
 SG_ S01PID6B_ExhaustGasTemp m107 : 31|8@0+ (1,0) [0|255] "" Vector__XXX
 SG_ S01PID6C_CmdThrottleActRel m108 : 31|8@0+ (1,0) [0|255] "" Vector__XXX
 SG_ S01PID6D_FuelPresContrSys m109 : 31|8@0+ (1,0) [0|255] "" Vector__XXX
 SG_ S01PID6E_InjPresContrSys m110 : 31|8@0+ (1,0) [0|255] "" Vector__XXX
 SG_ S01PID6F_TurboComprPres m111 : 31|8@0+ (1,0) [0|255] "" Vector__XXX
 SG_ S01PID70_BoostPresCntrl m112 : 31|8@0+ (1,0) [0|255] "" Vector__XXX
 SG_ S01PID80_PIDsSupported_81_A0 m128 : 31|32@0+ (1,0) [0|4294967295] "" Vector__XXX
 SG_ S01PID8E_EngFrictionPctTorq m142 : 31|8@0+ (1,-125) [-125|130] "%" Vector__XXX
 SG_ S01PIDA0_PIDsSupported_A1_C0 m160 : 31|32@0+ (1,0) [0|4294967295] "" Vector__XXX
 SG_ S01PIDC0_PIDsSupported_C1_E0 m192 : 31|32@0+ (1,0) [0|4294967295] "" Vector__XXX
 SG_ S02PID02_FreezeDTC m2 : 31|16@0+ (1,0) [0|65535] "" Vector__XXX
 SG_ S01PID m1M : 23|8@0+ (1,0) [0|255] "" Vector__XXX
 SG_ S02PID m2M : 23|8@0+ (1,0) [0|255] "" Vector__XXX
 SG_ Service M : 11|4@0+ (1,0) [0|15] "" Vector__XXX
 SG_ Response : 15|4@0+ (1,0) [0|15] "" Vector__XXX
 SG_ Length : 7|8@0+ (1,0) [0|255] "" Vector__XXX

CM_ BO_ 2564485397 "OBD2 0xDA00";
BA_DEF_ SG_  "SignalIgnore" INT 0 1;
BA_DEF_ BO_  "VFrameFormat" ENUM  "StandardCAN","ExtendedCAN","StandardCAN_FD","ExtendedCAN_FD","J1939PG";
BA_DEF_  "BusType" STRING ;
BA_DEF_  "ProtocolType" STRING ;
BA_DEF_  "DatabaseCompiler" STRING ;
BA_DEF_DEF_  "SignalIgnore" 0;
BA_DEF_DEF_  "VFrameFormat" "";
BA_DEF_DEF_  "BusType" "";
BA_DEF_DEF_  "ProtocolType" "";
BA_DEF_DEF_  "DatabaseCompiler" "CSS Electronics (wwww.csselectronics.com)";
BA_ "BusType" "CAN";
BA_ "ProtocolType" "OBD";
BA_ "VFrameFormat" BO_ 2564485397 4;
BA_ "SignalIgnore" SG_ 2564485397 S01PID 1;
BA_ "SignalIgnore" SG_ 2564485397 S02PID 1;
BA_ "SignalIgnore" SG_ 2564485397 Service 1;
BA_ "SignalIgnore" SG_ 2564485397 Response 1;
BA_ "SignalIgnore" SG_ 2564485397 Length 1;
VAL_ 2564485397 S01PID03_FuelSystemStatus 1 "Open loop (insuff. eng. temp.)" 2 "Closed loop (oxy sens)" 4 "Open loop (eng. load, fuel cut)" 8 "Open loop (system failure)" 16 "Closed loop (feedback issue)" ;
VAL_ 2564485397 S01PID12_CmdSecAirStatus 1 "Upstream" 2 "Downstream catalytic conv" 4 "From outside atmosphere/off" 8 "Pump cmd on for diagn." ;
VAL_ 2564485397 S01PID1C_OBDStandard 1 "OBD-II as defined by the CARB" 2 "OBD as defined by the EPA" 3 "OBD and OBD-II" 4 "OBD-I" 5 "Not OBD compliant" 6 "EOBD (Europe)" 7 "EOBD and OBD-II" 8 "EOBD and OBD" 9 "EOBD, OBD and OBD II" 10 "JOBD (Japan)" 11 "JOBD and OBD II" 12 "JOBD and EOBD" 13 "JOBD, EOBD, and OBD II" 14 "Reserved" 15 "Reserved" 16 "Reserved" 17 "Eng. Manu. Diag. (EMD)" 18 "EMD Enhanced (EMD+)" 19 "HD OBD-C" 20 "HD OBD" 21 "WWH OBD" 22 "Reserved" 23 "HD EOBD-I" 24 "HD EOBD-I N" 25 "HD EOBD-II" 26 "HD EOBD-II N" 27 "Reserved" 28 "OBDBr-1" 29 "OBDBr-2" 30 "KOBD" 31 "IOBD I" 32 "IOBD II" 33 "HD EOBD-IV" 34 "Reserved" 35 "Reserved" ;
VAL_ 2564485397 S01PID51_FuelType 0 "Not available" 1 "Gasoline" 2 "Methanol" 3 "Ethanol" 4 "Diesel" 5 "LPG" 6 "CNG" 7 "Propane" 8 "Electric" 9 "Bifuel running Gasoline" 10 "Bifuel running Methanol" 11 "Bifuel running Ethanol" 12 "Bifuel running LPG" 13 "Bifuel running CNG" 14 "Bifuel running Propane" 15 "Bifuel running Electricity" 16 "Bifuel electric/comb. eng." 17 "Hybrid gasoline" 18 "Hybrid Ethanol" 19 "Hybrid Diesel" 20 "Hybrid Electric" 21 "Hybrid running electric/comb." 22 "Hybrid Regenerative" 23 "Bifuel running diesel" ;
VAL_ 2564485397 S01PID 0 "S01PID00_PIDsSupported_01_20" 1 "S01PID01_MonitorStatus" 2 "S01PID02_FreezeDTC" 3 "S01PID03_FuelSystemStatus" 4 "S01PID04_CalcEngineLoad" 5 "S01PID05_EngineCoolantTemp" 6 "S01PID06_ShortFuelTrimBank1" 7 "S01PID07_LongFuelTrimBank1" 8 "S01PID08_ShortFuelTrimBank2" 9 "S01PID09_LongFuelTrimBank2" 10 "S01PID0A_FuelPressure" 11 "S01PID0B_IntakeManiAbsPress" 12 "S01PID0C_EngineRPM" 13 "S01PID0D_VehicleSpeed" 14 "S01PID0E_TimingAdvance" 15 "S01PID0F_IntakeAirTemperature" 16 "S01PID10_MAFAirFlowRate" 17 "S01PID11_ThrottlePosition" 18 "S01PID12_CmdSecAirStatus" 20 "S01PID14_OxySensor1" 21 "S01PID15_OxySensor2" 22 "S01PID16_OxySensor3" 23 "S01PID17_OxySensor4" 24 "S01PID18_OxySensor5" 25 "S01PID19_OxySensor6" 26 "S01PID1A_OxySensor7" 27 "S01PID1B_OxySensor8" 28 "S01PID1C_OBDStandard" 31 "S01PID1F_TimeSinceEngStart" 32 "S01PID20_PIDsSupported_21_40" 33 "S01PID21_DistanceMILOn" 34 "S01PID22_FuelRailPres" 35 "S01PID23_FuelRailGaug" 36 "S01PID24_OxySensor1" 37 "S01PID25_OxySensor2" 38 "S01PID26_OxySensor3" 39 "S01PID27_OxySensor4" 40 "S01PID28_OxySensor5" 41 "S01PID29_OxySensor6" 42 "S01PID2A_OxySensor7" 43 "S01PID2B_OxySensor8" 44 "S01PID2C_CmdEGR" 45 "S01PID2D_EGRError" 46 "S01PID2E_CmdEvapPurge" 47 "S01PID2F_FuelTankLevel" 48 "S01PID30_WarmUpsSinceCodeClear" 49 "S01PID31_DistanceSinceCodeClear" 50 "S01PID32_EvapSysVaporPres" 51 "S01PID33_AbsBaroPres" 52 "S01PID34_OxySensor1" 53 "S01PID35_OxySensor2" 54 "S01PID36_OxySensor3" 55 "S01PID37_OxySensor4" 56 "S01PID38_OxySensor5" 57 "S01PID39_OxySensor6" 58 "S01PID3A_OxySensor7" 59 "S01PID3B_OxySensor8" 60 "S01PID3C_CatTempBank1Sens1" 61 "S01PID3D_CatTempBank2Sens1" 62 "S01PID3E_CatTempBank1Sens2" 63 "S01PID3F_CatTempBank2Sens2" 64 "S01PID40_PIDsSupported_41_60" 65 "S01PID41_MonStatusDriveCycle" 66 "S01PID42_ControlModuleVolt" 67 "S01PID43_AbsLoadValue" 68 "S01PID44_FuelAirCmdEquiv" 69 "S01PID45_RelThrottlePos" 70 "S01PID46_AmbientAirTemp" 71 "S01PID47_AbsThrottlePosB" 72 "S01PID48_AbsThrottlePosC" 73 "S01PID49_AbsThrottlePosD" 74 "S01PID4A_AbsThrottlePosE" 75 "S01PID4B_AbsThrottlePosF" 76 "S01PID4C_CmdThrottleAct" 77 "S01PID4D_TimeRunMILOn" 78 "S01PID4E_TimeSinceCodeClear" 79 "S01PID4F_MaxMultiple" 80 "S01PID50_Max_AirFlowMAF" 81 "S01PID51_FuelType" 82 "S01PID52_EthanolFuelPct" 83 "S01PID53_AbsEvapSysVapPres" 84 "S01PID54_EvapSysVapPres" 85 "S01PID55_ShortSecOxyTrimBankX" 86 "S01PID56_LongSecOxyTrimBankX" 87 "S01PID57_ShortSecOxyTrimBankX" 88 "S01PID58_LongSecOxyTrimBankX" 89 "S01PID59_FuelRailAbsPres" 90 "S01PID5A_RelAccelPedalPos" 91 "S01PID5B_HybrBatPackRemLife" 92 "S01PID5C_EngineOilTemp" 93 "S01PID5D_FuelInjectionTiming" 94 "S01PID5E_EngineFuelRate" 95 "S01PID5F_EmissionReq" 96 "S01PID60_PIDsSupported_61_80" 97 "S01PID61_DemandEngTorqPct" 98 "S01PID62_ActualEngTorqPct" 99 "S01PID63_EngRefTorq" 100 "S01PID64_EngPctTorq" 101 "S01PID65_AuxInputOutput" 102 "S01PID66_MAFSensor" 103 "S01PID67_EngineCoolantTemp" 104 "S01PID68_IntakeAirTempSens" 105 "S01PID69_CmdEGR_EGRError" 106 "S01PID6A_CmdDieselIntAir" 107 "S01PID6B_ExhaustGasTemp" 108 "S01PID6C_CmdThrottleActRel" 109 "S01PID6D_FuelPresContrSys" 110 "S01PID6E_InjPresContrSys" 111 "S01PID6F_TurboComprPres" 112 "S01PID70_BoostPresCntrl" 128 "S01PID80_PIDsSupported_81_A0" 142 "S01PID8E_EngFrictionPctTorq" 160 "S01PIDA0_PIDsSupported_A1_C0" 192 "S01PIDC0_PIDsSupported_C1_E0" ;
VAL_ 2564485397 S02PID 2 "S02PID02_FreezeDTC" ;
VAL_ 2564485397 Service 10 "Permanent DTCs (Cleared DTCs) " 9 "Request vehicle information " 8 "Control on-board system " 7 "Show pending DTCs " 6 "Other system monitoring " 5 "Oxygen sensor monitoring " 4 "Clear DTCs and stored values" 3 "Show stored DTCs " 2 "Show freeze frame data " 1 "Show current data " ;

SG_MUL_VAL_ 2564485397 S01PID00_PIDsSupported_01_20 S01PID 0-0;
SG_MUL_VAL_ 2564485397 S01PID01_MonitorStatus S01PID 1-1;
SG_MUL_VAL_ 2564485397 S01PID02_FreezeDTC S01PID 2-2;
SG_MUL_VAL_ 2564485397 S01PID03_FuelSystemStatus S01PID 3-3;
SG_MUL_VAL_ 2564485397 S01PID04_CalcEngineLoad S01PID 4-4;
SG_MUL_VAL_ 2564485397 S01PID05_EngineCoolantTemp S01PID 5-5;
SG_MUL_VAL_ 2564485397 S01PID06_ShortFuelTrimBank1 S01PID 6-6;
SG_MUL_VAL_ 2564485397 S01PID07_LongFuelTrimBank1 S01PID 7-7;
SG_MUL_VAL_ 2564485397 S01PID08_ShortFuelTrimBank2 S01PID 8-8;
SG_MUL_VAL_ 2564485397 S01PID09_LongFuelTrimBank2 S01PID 9-9;
SG_MUL_VAL_ 2564485397 S01PID0A_FuelPressure S01PID 10-10;
SG_MUL_VAL_ 2564485397 S01PID0B_IntakeManiAbsPress S01PID 11-11;
SG_MUL_VAL_ 2564485397 S01PID0C_EngineRPM S01PID 12-12;
SG_MUL_VAL_ 2564485397 S01PID0D_VehicleSpeed S01PID 13-13;
SG_MUL_VAL_ 2564485397 S01PID0E_TimingAdvance S01PID 14-14;
SG_MUL_VAL_ 2564485397 S01PID0F_IntakeAirTemperature S01PID 15-15;
SG_MUL_VAL_ 2564485397 S01PID10_MAFAirFlowRate S01PID 16-16;
SG_MUL_VAL_ 2564485397 S01PID11_ThrottlePosition S01PID 17-17;
SG_MUL_VAL_ 2564485397 S01PID12_CmdSecAirStatus S01PID 18-18;
SG_MUL_VAL_ 2564485397 S01PID14_OxySensor1_Volt S01PID 20-20;
SG_MUL_VAL_ 2564485397 S01PID14_OxySensor1_STFT S01PID 20-20;
SG_MUL_VAL_ 2564485397 S01PID15_OxySensor2_Volt S01PID 21-21;
SG_MUL_VAL_ 2564485397 S01PID15_OxySensor2_STFT S01PID 21-21;
SG_MUL_VAL_ 2564485397 S01PID16_OxySensor3_Volt S01PID 22-22;
SG_MUL_VAL_ 2564485397 S01PID16_OxySensor3_STFT S01PID 22-22;
SG_MUL_VAL_ 2564485397 S01PID17_OxySensor4_Volt S01PID 23-23;
SG_MUL_VAL_ 2564485397 S01PID17_OxySensor4_STFT S01PID 23-23;
SG_MUL_VAL_ 2564485397 S01PID18_OxySensor5_Volt S01PID 24-24;
SG_MUL_VAL_ 2564485397 S01PID18_OxySensor5_STFT S01PID 24-24;
SG_MUL_VAL_ 2564485397 S01PID19_OxySensor6_Volt S01PID 25-25;
SG_MUL_VAL_ 2564485397 S01PID19_OxySensor6_STFT S01PID 25-25;
SG_MUL_VAL_ 2564485397 S01PID1A_OxySensor7_Volt S01PID 26-26;
SG_MUL_VAL_ 2564485397 S01PID1A_OxySensor7_STFT S01PID 26-26;
SG_MUL_VAL_ 2564485397 S01PID1B_OxySensor8_Volt S01PID 27-27;
SG_MUL_VAL_ 2564485397 S01PID1B_OxySensor8_STFT S01PID 27-27;
SG_MUL_VAL_ 2564485397 S01PID1C_OBDStandard S01PID 28-28;
SG_MUL_VAL_ 2564485397 S01PID1F_TimeSinceEngStart S01PID 31-31;
SG_MUL_VAL_ 2564485397 S01PID20_PIDsSupported_21_40 S01PID 32-32;
SG_MUL_VAL_ 2564485397 S01PID21_DistanceMILOn S01PID 33-33;
SG_MUL_VAL_ 2564485397 S01PID22_FuelRailPres S01PID 34-34;
SG_MUL_VAL_ 2564485397 S01PID23_FuelRailGaug S01PID 35-35;
SG_MUL_VAL_ 2564485397 S01PID24_OxySensor1_FAER S01PID 36-36;
SG_MUL_VAL_ 2564485397 S01PID24_OxySensor1_Volt S01PID 36-36;
SG_MUL_VAL_ 2564485397 S01PID25_OxySensor2_FAER S01PID 37-37;
SG_MUL_VAL_ 2564485397 S01PID25_OxySensor2_Volt S01PID 37-37;
SG_MUL_VAL_ 2564485397 S01PID26_OxySensor3_FAER S01PID 38-38;
SG_MUL_VAL_ 2564485397 S01PID26_OxySensor3_Volt S01PID 38-38;
SG_MUL_VAL_ 2564485397 S01PID27_OxySensor4_FAER S01PID 39-39;
SG_MUL_VAL_ 2564485397 S01PID27_OxySensor4_Volt S01PID 39-39;
SG_MUL_VAL_ 2564485397 S01PID28_OxySensor5_FAER S01PID 40-40;
SG_MUL_VAL_ 2564485397 S01PID28_OxySensor5_Volt S01PID 40-40;
SG_MUL_VAL_ 2564485397 S01PID29_OxySensor6_FAER S01PID 41-41;
SG_MUL_VAL_ 2564485397 S01PID29_OxySensor6_Volt S01PID 41-41;
SG_MUL_VAL_ 2564485397 S01PID2A_OxySensor7_FAER S01PID 42-42;
SG_MUL_VAL_ 2564485397 S01PID2A_OxySensor7_Volt S01PID 42-42;
SG_MUL_VAL_ 2564485397 S01PID2B_OxySensor8_FAER S01PID 43-43;
SG_MUL_VAL_ 2564485397 S01PID2B_OxySensor8_Volt S01PID 43-43;
SG_MUL_VAL_ 2564485397 S01PID2C_CmdEGR S01PID 44-44;
SG_MUL_VAL_ 2564485397 S01PID2D_EGRError S01PID 45-45;
SG_MUL_VAL_ 2564485397 S01PID2E_CmdEvapPurge S01PID 46-46;
SG_MUL_VAL_ 2564485397 S01PID2F_FuelTankLevel S01PID 47-47;
SG_MUL_VAL_ 2564485397 S01PID30_WarmUpsSinceCodeClear S01PID 48-48;
SG_MUL_VAL_ 2564485397 S01PID31_DistanceSinceCodeClear S01PID 49-49;
SG_MUL_VAL_ 2564485397 S01PID32_EvapSysVaporPres S01PID 50-50;
SG_MUL_VAL_ 2564485397 S01PID33_AbsBaroPres S01PID 51-51;
SG_MUL_VAL_ 2564485397 S01PID34_OxySensor1_FAER S01PID 52-52;
SG_MUL_VAL_ 2564485397 S01PID34_OxySensor1_Crnt S01PID 52-52;
SG_MUL_VAL_ 2564485397 S01PID35_OxySensor2_FAER S01PID 53-53;
SG_MUL_VAL_ 2564485397 S01PID35_OxySensor2_Crnt S01PID 53-53;
SG_MUL_VAL_ 2564485397 S01PID36_OxySensor3_FAER S01PID 54-54;
SG_MUL_VAL_ 2564485397 S01PID36_OxySensor3_Crnt S01PID 54-54;
SG_MUL_VAL_ 2564485397 S01PID37_OxySensor4_FAER S01PID 55-55;
SG_MUL_VAL_ 2564485397 S01PID37_OxySensor4_Crnt S01PID 55-55;
SG_MUL_VAL_ 2564485397 S01PID38_OxySensor5_FAER S01PID 56-56;
SG_MUL_VAL_ 2564485397 S01PID38_OxySensor5_Crnt S01PID 56-56;
SG_MUL_VAL_ 2564485397 S01PID39_OxySensor6_FAER S01PID 57-57;
SG_MUL_VAL_ 2564485397 S01PID39_OxySensor6_Crnt S01PID 57-57;
SG_MUL_VAL_ 2564485397 S01PID3A_OxySensor7_FAER S01PID 58-58;
SG_MUL_VAL_ 2564485397 S01PID3A_OxySensor7_Crnt S01PID 58-58;
SG_MUL_VAL_ 2564485397 S01PID3B_OxySensor8_FAER S01PID 59-59;
SG_MUL_VAL_ 2564485397 S01PID3B_OxySensor8_Crnt S01PID 59-59;
SG_MUL_VAL_ 2564485397 S01PID3C_CatTempBank1Sens1 S01PID 60-60;
SG_MUL_VAL_ 2564485397 S01PID3D_CatTempBank2Sens1 S01PID 61-61;
SG_MUL_VAL_ 2564485397 S01PID3E_CatTempBank1Sens2 S01PID 62-62;
SG_MUL_VAL_ 2564485397 S01PID3F_CatTempBank2Sens2 S01PID 63-63;
SG_MUL_VAL_ 2564485397 S01PID40_PIDsSupported_41_60 S01PID 64-64;
SG_MUL_VAL_ 2564485397 S01PID41_MonStatusDriveCycle S01PID 65-65;
SG_MUL_VAL_ 2564485397 S01PID42_ControlModuleVolt S01PID 66-66;
SG_MUL_VAL_ 2564485397 S01PID43_AbsLoadValue S01PID 67-67;
SG_MUL_VAL_ 2564485397 S01PID44_FuelAirCmdEquiv S01PID 68-68;
SG_MUL_VAL_ 2564485397 S01PID45_RelThrottlePos S01PID 69-69;
SG_MUL_VAL_ 2564485397 S01PID46_AmbientAirTemp S01PID 70-70;
SG_MUL_VAL_ 2564485397 S01PID47_AbsThrottlePosB S01PID 71-71;
SG_MUL_VAL_ 2564485397 S01PID48_AbsThrottlePosC S01PID 72-72;
SG_MUL_VAL_ 2564485397 S01PID49_AbsThrottlePosD S01PID 73-73;
SG_MUL_VAL_ 2564485397 S01PID4A_AbsThrottlePosE S01PID 74-74;
SG_MUL_VAL_ 2564485397 S01PID4B_AbsThrottlePosF S01PID 75-75;
SG_MUL_VAL_ 2564485397 S01PID4C_CmdThrottleAct S01PID 76-76;
SG_MUL_VAL_ 2564485397 S01PID4D_TimeRunMILOn S01PID 77-77;
SG_MUL_VAL_ 2564485397 S01PID4E_TimeSinceCodeClear S01PID 78-78;
SG_MUL_VAL_ 2564485397 S01PID4F_Max_FAER S01PID 79-79;
SG_MUL_VAL_ 2564485397 S01PID4F_Max_OxySensVol S01PID 79-79;
SG_MUL_VAL_ 2564485397 S01PID4F_Max_OxySensCrnt S01PID 79-79;
SG_MUL_VAL_ 2564485397 S01PID4F_Max_IntManiAbsPres S01PID 79-79;
SG_MUL_VAL_ 2564485397 S01PID50_Max_AirFlowMAF S01PID 80-80;
SG_MUL_VAL_ 2564485397 S01PID51_FuelType S01PID 81-81;
SG_MUL_VAL_ 2564485397 S01PID52_EthanolFuelPct S01PID 82-82;
SG_MUL_VAL_ 2564485397 S01PID53_AbsEvapSysVapPres S01PID 83-83;
SG_MUL_VAL_ 2564485397 S01PID54_EvapSysVapPres S01PID 84-84;
SG_MUL_VAL_ 2564485397 S01PID55_ShortSecOxyTrimBank1 S01PID 85-85;
SG_MUL_VAL_ 2564485397 S01PID55_ShortSecOxyTrimBank3 S01PID 85-85;
SG_MUL_VAL_ 2564485397 S01PID56_LongSecOxyTrimBank1 S01PID 86-86;
SG_MUL_VAL_ 2564485397 S01PID56_LongSecOxyTrimBank3 S01PID 86-86;
SG_MUL_VAL_ 2564485397 S01PID57_ShortSecOxyTrimBank2 S01PID 87-87;
SG_MUL_VAL_ 2564485397 S01PID57_ShortSecOxyTrimBank4 S01PID 87-87;
SG_MUL_VAL_ 2564485397 S01PID58_LongSecOxyTrimBank2 S01PID 88-88;
SG_MUL_VAL_ 2564485397 S01PID58_LongSecOxyTrimBank4 S01PID 88-88;
SG_MUL_VAL_ 2564485397 S01PID59_FuelRailAbsPres S01PID 89-89;
SG_MUL_VAL_ 2564485397 S01PID5A_RelAccelPedalPos S01PID 90-90;
SG_MUL_VAL_ 2564485397 S01PID5B_HybrBatPackRemLife S01PID 91-91;
SG_MUL_VAL_ 2564485397 S01PID5C_EngineOilTemp S01PID 92-92;
SG_MUL_VAL_ 2564485397 S01PID5D_FuelInjectionTiming S01PID 93-93;
SG_MUL_VAL_ 2564485397 S01PID5E_EngineFuelRate S01PID 94-94;
SG_MUL_VAL_ 2564485397 S01PID5F_EmissionReq S01PID 95-95;
SG_MUL_VAL_ 2564485397 S01PID60_PIDsSupported_61_80 S01PID 96-96;
SG_MUL_VAL_ 2564485397 S01PID61_DemandEngTorqPct S01PID 97-97;
SG_MUL_VAL_ 2564485397 S01PID62_ActualEngTorqPct S01PID 98-98;
SG_MUL_VAL_ 2564485397 S01PID63_EngRefTorq S01PID 99-99;
SG_MUL_VAL_ 2564485397 S01PID64_EngPctTorq_Idle S01PID 100-100;
SG_MUL_VAL_ 2564485397 S01PID64_EngPctTorq_EP1 S01PID 100-100;
SG_MUL_VAL_ 2564485397 S01PID64_EngPctTorq_EP2 S01PID 100-100;
SG_MUL_VAL_ 2564485397 S01PID64_EngPctTorq_EP3 S01PID 100-100;
SG_MUL_VAL_ 2564485397 S01PID64_EngPctTorq_EP4 S01PID 100-100;
SG_MUL_VAL_ 2564485397 S01PID65_AuxInputOutput S01PID 101-101;
SG_MUL_VAL_ 2564485397 S01PID66_MAFSensor S01PID 102-102;
SG_MUL_VAL_ 2564485397 S01PID67_EngineCoolantTemp S01PID 103-103;
SG_MUL_VAL_ 2564485397 S01PID68_IntakeAirTempSens S01PID 104-104;
SG_MUL_VAL_ 2564485397 S01PID69_CmdEGR_EGRError S01PID 105-105;
SG_MUL_VAL_ 2564485397 S01PID6A_CmdDieselIntAir S01PID 106-106;
SG_MUL_VAL_ 2564485397 S01PID6B_ExhaustGasTemp S01PID 107-107;
SG_MUL_VAL_ 2564485397 S01PID6C_CmdThrottleActRel S01PID 108-108;
SG_MUL_VAL_ 2564485397 S01PID6D_FuelPresContrSys S01PID 109-109;
SG_MUL_VAL_ 2564485397 S01PID6E_InjPresContrSys S01PID 110-110;
SG_MUL_VAL_ 2564485397 S01PID6F_TurboComprPres S01PID 111-111;
SG_MUL_VAL_ 2564485397 S01PID70_BoostPresCntrl S01PID 112-112;
SG_MUL_VAL_ 2564485397 S01PID80_PIDsSupported_81_A0 S01PID 128-128;
SG_MUL_VAL_ 2564485397 S01PID8E_EngFrictionPctTorq S01PID 142-142;
SG_MUL_VAL_ 2564485397 S01PIDA0_PIDsSupported_A1_C0 S01PID 160-160;
SG_MUL_VAL_ 2564485397 S01PIDC0_PIDsSupported_C1_E0 S01PID 192-192;
SG_MUL_VAL_ 2564485397 S02PID02_FreezeDTC S02PID 2-2;
SG_MUL_VAL_ 2564485397 S01PID Service 1-1;
SG_MUL_VAL_ 2564485397 S02PID Service 2-2;
